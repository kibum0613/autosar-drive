AUTOSAR XML (schema 00052)
package /Components/SwcImplementations
  swc implementation AEB_Core_SWC_Impl: programming-language=C, sw-version=1.2.1, used-code-generator=Embedded Coder 25.2 (R2025b) 28-Jul-2025, vendor-id=0, behavior=AEB_Core_SWC_IB
    code-descriptors:
      code Code
        artifact-descriptors:
          short-label=AEB_Core_SWC_c, category=SWSRC
          short-label=AEB_Core_SWC_h, category=SWHDR
          short-label=AEB_Core_SWC_private_h, category=SWHDR
          short-label=AEB_Core_SWC_types_h, category=SWHDR
    resource consumption RsrcCons_AEB_Core_SWC
