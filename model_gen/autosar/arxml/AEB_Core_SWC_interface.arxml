AUTOSAR XML (schema 00052)
package /Interfaces
  6 x sender receiver interface:
    RelDistance
      data RelDistance: category=VALUE, sw-calibration-access=READ-ONLY, type=float64
    LeadLatOffset
      data LeadLatOffset: category=VALUE, sw-calibration-access=READ-ONLY, type=float64
    RelVelocity
      data RelVelocity: category=VALUE, sw-calibration-access=READ-ONLY, type=float64
    EgoVelocity
      data EgoVelocity: category=VALUE, sw-calibration-access=READ-ONLY, type=float64
    AEBTrigger
      data AEBTrigger: category=VALUE, sw-calibration-access=READ-ONLY, type=float64
    Deceleration
      data Deceleration: category=VALUE, sw-calibration-access=READ-ONLY, type=float64
